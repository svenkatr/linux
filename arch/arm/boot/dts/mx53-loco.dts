/*
 * Copyright 2011 Linaro Ltd.
 *
 * The code contained herein is licensed under the GNU General Public
 * License. You may obtain a copy of the GNU General Public License
 * Version 2 or later at the following locations:
 *
 * http://www.opensource.org/licenses/gpl-license.html
 * http://www.gnu.org/copyleft/gpl.html
 */

/dts-v1/;
/include/ "skeleton.dtsi"

/ {
	model = "Freescale i.MX53 LOCO";
	compatible = "fsl,mx53-loco", "fsl,mx53";

	memory {
		reg = <0x70000000 0x40000000>;
	};
};
